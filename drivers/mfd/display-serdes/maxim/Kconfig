## drivers/mfd/display-serdes/maxim/Kconfig
```kconfig
# SPDX-License-Identifier: GPL-2.0
#
# maxim display serdes drivers configuration
#

menuconfig SERDES_DISPLAY_CHIP_MAXIM
	bool "maxim serdes device support"
	default y
	help
	  Enable this to be able to choose the drivers for controlling the
	  maxim serdes.

if SERDES_DISPLAY_CHIP_MAXIM
config SERDES_DISPLAY_CHIP_MAXIM_MAX96745
	bool "maxim max96745 serdes"
	default y
	help
	  To support maxim max96745 display serdes.

config SERDES_DISPLAY_CHIP_MAXIM_MAX96749
	bool "maxim max96749 serdes"
	default y
	help
	  To support maxim max96749 display serdes.

config SERDES_DISPLAY_CHIP_MAXIM_MAX96752
	bool "maxim max96752 serdes"
	default y
	help
	  To support maxim max96752 display serdes.

config SERDES_DISPLAY_CHIP_MAXIM_MAX96755
	bool "maxim max96755 serdes"
	default y
	help
	  To support maxim max96755 display serdes.

config SERDES_DISPLAY_CHIP_MAXIM_MAX96772
	bool "maxim max96772 serdes"
	default y
	help
	  To support maxim max96772 display serdes.

config SERDES_DISPLAY_CHIP_MAXIM_MAX96789
	bool "maxim max96789 serdes"
	default y
	help
	  To support maxim max96789 display serdes.

endif
```

## drivers/mfd/display-serdes/rockchip/Kconfig
```kconfig
# SPDX-License-Identifier: GPL-2.0
#
# rockchip display serdes drivers configuration
#

menuconfig SERDES_DISPLAY_CHIP_ROCKCHIP
	bool "rockchip serdes device support"
	default y
	help
	  Enable this to be able to choose the drivers for controlling the
	  rockchip serdes.

if SERDES_DISPLAY_CHIP_ROCKCHIP
config SERDES_DISPLAY_CHIP_ROCKCHIP_RKX111
	bool "rockchip rkx111 serdes"
	default y
	help
	  To support rockchip rkx111 display serdes.

config SERDES_DISPLAY_CHIP_ROCKCHIP_RKX121
	bool "rockchip rkx121 serdes"
	default y
	help
	  To support rockchip rkx121 display serdes.
endif
```
